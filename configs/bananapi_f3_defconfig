## configs/bananapi_f3_defconfig
```kconfig
# Architecture
BR2_riscv=y
BR2_riscv_custom=y
BR2_RISCV_ISA_RVM=y
BR2_RISCV_ISA_RVA=y
BR2_RISCV_ISA_RVF=y
BR2_RISCV_ISA_RVD=y
BR2_RISCV_ISA_RVC=y
BR2_RISCV_64=y
BR2_RISCV_ABI_LP64D=y

# System
BR2_ROOTFS_POST_BUILD_SCRIPT="board/bananapi/bananapi-f3/post-build.sh"
BR2_ROOTFS_POST_IMAGE_SCRIPT="support/scripts/genimage.sh"
BR2_ROOTFS_POST_SCRIPT_ARGS="-c board/bananapi/bananapi-f3/genimage.cfg"

# Filesystem
BR2_TARGET_ROOTFS_EXT2=y
BR2_TARGET_ROOTFS_EXT2_4=y

# Linux headers same as kernel, a 6.1 series
BR2_PACKAGE_HOST_LINUX_HEADERS_CUSTOM_6_1=y

# Kernel
BR2_LINUX_KERNEL=y
BR2_LINUX_KERNEL_CUSTOM_GIT=y
BR2_LINUX_KERNEL_CUSTOM_REPO_URL="https://gitee.com/bianbu-linux/linux-6.1.git"
BR2_LINUX_KERNEL_CUSTOM_REPO_VERSION="95d774caeae5409927384a2984e3ad5badf74cf6"
BR2_LINUX_KERNEL_USE_DEFCONFIG=y
BR2_LINUX_KERNEL_DEFCONFIG="k1"
BR2_LINUX_KERNEL_DTS_SUPPORT=y
BR2_LINUX_KERNEL_CUSTOM_DTS_PATH="board/bananapi/bananapi-f3/bananapi-f3.dts"
BR2_LINUX_KERNEL_DTB_OVERLAY_SUPPORT=y
BR2_LINUX_KERNEL_NEEDS_HOST_OPENSSL=y
BR2_LINUX_KERNEL_CONFIG_FRAGMENT_FILES="board/bananapi/bananapi-f3/linux.fragment"

# Bootloader
BR2_TARGET_OPENSBI=y
BR2_TARGET_OPENSBI_CUSTOM_GIT=y
BR2_TARGET_OPENSBI_CUSTOM_REPO_URL="https://gitee.com/bianbu-linux/opensbi.git"
BR2_TARGET_OPENSBI_CUSTOM_REPO_VERSION="94bf83cc0bd1c86e51f48174fa17e23427903c59"
BR2_TARGET_OPENSBI_PLAT="generic"
BR2_TARGET_OPENSBI_ADDITIONAL_VARIABLES="PLATFORM_DEFCONFIG=k1_defconfig"
BR2_TARGET_UBOOT=y
BR2_TARGET_UBOOT_CUSTOM_GIT=y
BR2_TARGET_UBOOT_CUSTOM_REPO_URL="https://gitee.com/bianbu-linux/uboot-2022.10.git"
BR2_TARGET_UBOOT_CUSTOM_REPO_VERSION="41499876c85f19ff73b4450eca69bf3405a9d4a9"
BR2_TARGET_UBOOT_BUILD_SYSTEM_KCONFIG=y
BR2_TARGET_UBOOT_BOARD_DEFCONFIG="k1"
BR2_TARGET_UBOOT_NEEDS_DTC=y
BR2_TARGET_UBOOT_NEEDS_OPENSBI=y
BR2_TARGET_UBOOT_NEEDS_OPENSSL=y
BR2_TARGET_UBOOT_SPL=y

# Host tools
BR2_PACKAGE_HOST_GENIMAGE=y
BR2_PACKAGE_HOST_MTOOLS=y
BR2_PACKAGE_HOST_UBOOT_TOOLS=y
BR2_PACKAGE_HOST_UBOOT_TOOLS_FIT_SUPPORT=y
```

## configs/sipeed_lichee_rv_nano_defconfig
```kconfig
BR2_riscv=y
BR2_TOOLCHAIN_EXTERNAL=y
BR2_ROOTFS_OVERLAY="board/sophgo/licheerv_nano/overlay/"
BR2_ROOTFS_POST_IMAGE_SCRIPT="support/scripts/genimage.sh"
BR2_ROOTFS_POST_SCRIPT_ARGS="-c board/sophgo/licheerv_nano/genimage.cfg"
BR2_LINUX_KERNEL=y
BR2_LINUX_KERNEL_CUSTOM_VERSION=y
BR2_LINUX_KERNEL_CUSTOM_VERSION_VALUE="6.13"
BR2_LINUX_KERNEL_USE_ARCH_DEFAULT_CONFIG=y
BR2_LINUX_KERNEL_DTS_SUPPORT=y
BR2_LINUX_KERNEL_INTREE_DTS_NAME="sophgo/sg2002-licheerv-nano-b"
BR2_LINUX_KERNEL_INSTALL_TARGET=y
BR2_LINUX_KERNEL_NEEDS_HOST_OPENSSL=y
BR2_TARGET_ROOTFS_EXT2=y
BR2_TARGET_ROOTFS_EXT2_4=y
BR2_TARGET_ROOTFS_EXT2_SIZE="100M"
# BR2_TARGET_ROOTFS_TAR is not set
BR2_TARGET_OPENSBI=y
BR2_TARGET_OPENSBI_CUSTOM_VERSION=y
BR2_TARGET_OPENSBI_CUSTOM_VERSION_VALUE="1.5"
BR2_TARGET_OPENSBI_PLAT="generic"
# BR2_TARGET_OPENSBI_INSTALL_JUMP_IMG is not set
BR2_TARGET_OPENSBI_FW_FDT_PATH=y
BR2_TARGET_UBOOT=y
BR2_TARGET_UBOOT_BUILD_SYSTEM_KCONFIG=y
BR2_TARGET_UBOOT_CUSTOM_GIT=y
BR2_TARGET_UBOOT_CUSTOM_REPO_URL="https://github.com/u-boot/u-boot"
BR2_TARGET_UBOOT_CUSTOM_REPO_VERSION="9bfc72e3b2af4d426e712fe8d8165ebd1dcf74b9"
BR2_TARGET_UBOOT_BOARD_DEFCONFIG="sipeed_licheerv_nano"
BR2_PACKAGE_HOST_GENIMAGE=y
BR2_PACKAGE_HOST_SOPHGO_FIPTOOL=y
BR2_PACKAGE_HOST_SOPHGO_FIPTOOL_CV181X=y
BR2_PACKAGE_HOST_UBOOT_TOOLS=y
BR2_PACKAGE_HOST_UBOOT_TOOLS_FIT_SUPPORT=y
```

## package/libplacebo/Config.in
```kconfig
config BR2_PACKAGE_LIBPLACEBO
	bool "libplacebo"
	select BR2_PACKAGE_LCMS2
	select BR2_PACKAGE_PYTHON_GLAD2
	select BR2_PACKAGE_VULKAN_HEADERS
	help
	  Core rendering algorithms and ideas of mpv rewritten as an
	  independent library.

	  https://code.videolan.org/videolan/libplacebo
```

## package/python-glad2/Config.in
```kconfig
config BR2_PACKAGE_PYTHON_GLAD2
	bool "python-glad2"
	select BR2_PACKAGE_PYTHON_JINJA2
	help
	  Multi-Language Vulkan/GL/GLES/EGL/GLX/WGL Loader-Generator based on
	  the official specs.

	  https://github.com/Dav1dde/glad
```

## package/sophgo-fiptool/Config.in.host
```kconfig
config BR2_PACKAGE_HOST_SOPHGO_FIPTOOL
	bool "host sophgo-fiptool"
	depends on BR2_riscv
	depends on BR2_TARGET_UBOOT_FORMAT_BIN
	help
	  Generate the Firmware Image Package based on Sophgo software.

	  https://github.com/sophgo/fiptool

if BR2_PACKAGE_HOST_SOPHGO_FIPTOOL
choice
prompt "Sophgo SoC family"
config BR2_PACKAGE_HOST_SOPHGO_FIPTOOL_CV180X
	bool "Sophgo CV180X"

config BR2_PACKAGE_HOST_SOPHGO_FIPTOOL_CV181X
	bool "Sophgo CV181X/SG200X"

endchoice
endif
```
